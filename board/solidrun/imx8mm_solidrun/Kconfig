## board/solidrun/imx8mm_solidrun/Kconfig
```kconfig
if TARGET_IMX8MM_SOLIDRUN || TARGET_IMX8MM_DDR4_SOLIDRUN

config SYS_BOARD
	default "imx8mm_solidrun"

config SYS_VENDOR
	default "solidrun"

config SYS_CONFIG_NAME
	default "imx8mm_solidrun"

source "board/freescale/common/Kconfig"

endif
```
